/*
 * Base keymap — Dvorak US layout with urob-style homerow mods.
 *
 * This file is board-agnostic. Each board's .keymap includes this file after
 * defining:
 *   - CONFIG_WIRELESS (if applicable)
 *   - ZMK_BASE_LAYER(name, LT, RT, LM, RM, LB, RB, LH, RH)
 *     macro that wraps ZMK_LAYER with extra board-specific keys (encoders, etc.)
 *   - #include "zmk-helpers/key-labels/<N>.h" for the appropriate key count
 *
 * Architecture inspired by github.com/urob/zmk-config.
 *
 * Layer map (mirrors Moonlander "valhalla-36-homerowmods-emacs-an"):
 *   0  DEF      Dvorak base
 *   1  SYML     Symbols-left  (hold RH2/ENT)
 *   2  SYMR     Symbols-right (hold LH2/DEL)
 *   3  FN       Function keys (hold RH1/BSPC)
 *   4  NUM      Number pad    (hold LH1/SPC)
 *   5  NAV      Navigation    (hold LH0/ESC)
 *   6  MOUSE    Mouse         (hold RH0/TAB)
 *   7  EMACS_N  Emacs nav     (hold I)
 *   8  EMACS_W  Emacs win/buf (hold D)
 *   9  SYS      System/BT     (FN + NUM)
 */

#include <behaviors.dtsi>
#include <zmk-helpers/helper.h>
#include <dt-bindings/zmk/keys.h>

#include "mouse.dtsi"

#ifdef CONFIG_WIRELESS
  #include <dt-bindings/zmk/bt.h>
  #include <dt-bindings/zmk/outputs.h>
  #define _BT_SEL_KEYS_                                                        \
      &bt BT_SEL 0 &bt BT_SEL 1 &bt BT_SEL 2 &bt BT_SEL 3 &bt BT_CLR
#else
  #define _BT_SEL_KEYS_ &trans &trans &trans &trans &trans
#endif

#ifdef CONFIG_HAS_RGB_UNDERGLOW
  #include <dt-bindings/zmk/rgb.h>
  #define _RGB_TOG_ &rgb_ug RGB_TOG
#else
  #define _RGB_TOG_ &trans
#endif

/* ── Layer indices ─────────────────────────────────────────────────────────── */

#define DEF     0
#define SYML    1
#define SYMR    2
#define FN      3
#define NUM     4
#define NAV     5
#define MOUSE   6
#define EMACS_N 7
#define EMACS_W 8
#define SYS     9

/* ── Shorthand ─────────────────────────────────────────────────────────────── */

#define XXX &none
#define ___ &trans

/* ── Global defaults ───────────────────────────────────────────────────────── */

#define QUICK_TAP_MS 175

&sk {
  release-after-ms = <900>;
  quick-release;
};

&sl {
  ignore-modifiers;
};

&lt {
  flavor = "balanced";
  tapping-term-ms = <200>;
  quick-tap-ms = <QUICK_TAP_MS>;
};

/* ── Homerow mods (urob "timeless" HRMs) ───────────────────────────────────
 *
 * - `balanced` flavor: hold registers when another key is pressed AND released.
 * - `require-prior-idle-ms = <150>`: if you tapped a key < 150 ms ago, the
 *   HRM immediately resolves as a tap (eliminates delay during fast typing).
 * - `hold-trigger-key-positions`: only keys on the OPPOSITE hand (+ thumbs)
 *   can trigger a hold. Same-hand keys always produce a tap.
 * - `hold-trigger-on-release`: the positional check happens when the next key
 *   is *released*, allowing you to combine multiple mods on the same hand.
 *
 * Troubleshooting:
 *   - Noticeable delay when tapping HRMs → increase require-prior-idle-ms
 *   - False negatives (same-hand) → decrease tapping-term-ms
 *   - False negatives (cross-hand) → decrease require-prior-idle-ms
 *   - False positives (same-hand) → increase tapping-term-ms
 *   - False positives (cross-hand) → increase require-prior-idle-ms
 * ──────────────────────────────────────────────────────────────────────────── */

#ifndef KEYS_L
#define KEYS_L LT0 LT1 LT2 LT3 LT4 LM0 LM1 LM2 LM3 LM4 LB0 LB1 LB2 LB3 LB4
#endif
#ifndef KEYS_R
#define KEYS_R RT0 RT1 RT2 RT3 RT4 RM0 RM1 RM2 RM3 RM4 RB0 RB1 RB2 RB3 RB4
#endif
#ifndef THUMBS
#define THUMBS LH2 LH1 LH0 RH0 RH1 RH2
#endif

#define MAKE_HRM(NAME, HOLD, TAP, TRIGGER_POS)                                 \
  ZMK_HOLD_TAP(NAME, bindings = <HOLD>, <TAP>; flavor = "balanced";            \
               tapping-term-ms = <280>; quick-tap-ms = <QUICK_TAP_MS>;         \
               require-prior-idle-ms = <150>; hold-trigger-on-release;         \
               hold-trigger-key-positions = <TRIGGER_POS>;)

/* Shift-specific HRM: no require-prior-idle so shift always has a chance to
 * activate as a hold, even during fast typing.  Positional filtering alone
 * is sufficient to prevent false activations (verified by diagnostic tests
 * 1, 2 & 6 — same-hand rolls were 100% clean). */
#define MAKE_HRM_SHIFT(NAME, HOLD, TAP, TRIGGER_POS)                           \
  ZMK_HOLD_TAP(NAME, bindings = <HOLD>, <TAP>; flavor = "balanced";            \
               tapping-term-ms = <280>; quick-tap-ms = <QUICK_TAP_MS>;         \
               hold-trigger-on-release;                                        \
               hold-trigger-key-positions = <TRIGGER_POS>;)

MAKE_HRM(hml, &kp, &kp, KEYS_R THUMBS)       // Left-hand HRMs.
MAKE_HRM(hmr, &kp, &kp, KEYS_L THUMBS)       // Right-hand HRMs.
MAKE_HRM_SHIFT(hml_s, &kp, &kp, KEYS_R THUMBS)  // Left-hand shift HRM.
MAKE_HRM_SHIFT(hmr_s, &kp, &kp, KEYS_L THUMBS)  // Right-hand shift HRM.

/* Layer-tap HRMs for inner index keys (I → Emacs Nav, D → Emacs Win).
 * These use &mo for hold instead of &kp, but keep the same positional/timing
 * settings so they feel identical to the other HRMs. */
MAKE_HRM(hml_l, &mo, &kp, KEYS_R THUMBS) // Left-hand layer-tap HRM.
MAKE_HRM(hmr_l, &mo, &kp, KEYS_L THUMBS) // Right-hand layer-tap HRM.

/* ── Emacs macros (C-x sequences) ──────────────────────────────────────────
 *
 * ZMK macros for Emacs C-x prefix commands used on the EMACS_W layer.
 * Each sends C-x followed by the appropriate key/chord.
 * ──────────────────────────────────────────────────────────────────────────── */

ZMK_MACRO(cx_0,   bindings = <&kp LC(X)>, <&kp N0>;       wait-ms = <30>; tap-ms = <30>;)  // C-x 0 (delete window)
ZMK_MACRO(cx_1,   bindings = <&kp LC(X)>, <&kp N1>;       wait-ms = <30>; tap-ms = <30>;)  // C-x 1 (delete other windows)
ZMK_MACRO(cx_2,   bindings = <&kp LC(X)>, <&kp N2>;       wait-ms = <30>; tap-ms = <30>;)  // C-x 2 (split below)
ZMK_MACRO(cx_3,   bindings = <&kp LC(X)>, <&kp N3>;       wait-ms = <30>; tap-ms = <30>;)  // C-x 3 (split right)
ZMK_MACRO(cx_o,   bindings = <&kp LC(X)>, <&kp O>;        wait-ms = <30>; tap-ms = <30>;)  // C-x o (other window)
ZMK_MACRO(cx_b,   bindings = <&kp LC(X)>, <&kp B>;        wait-ms = <30>; tap-ms = <30>;)  // C-x b (switch buffer)
ZMK_MACRO(cx_cs,  bindings = <&kp LC(X)>, <&kp LC(S)>;    wait-ms = <30>; tap-ms = <30>;)  // C-x C-s (save)
ZMK_MACRO(cx_cw,  bindings = <&kp LC(X)>, <&kp LC(W)>;    wait-ms = <30>; tap-ms = <30>;)  // C-x C-w (write file)
ZMK_MACRO(cx_k,   bindings = <&kp LC(X)>, <&kp K>;        wait-ms = <30>; tap-ms = <30>;)  // C-x k (kill buffer)
ZMK_MACRO(cx_cf,  bindings = <&kp LC(X)>, <&kp LC(F)>;    wait-ms = <30>; tap-ms = <30>;)  // C-x C-f (find file)

/* ── Tap-dances (Emacs Navigation layer) ───────────────────────────────────
 *
 * Ported from Moonlander DANCE_0/1/2. Original used "double-hold" to trigger
 * the alternate action; ZMK tap-dance only supports tap counts, so we use
 * double-tap instead (tap once = primary, tap twice = alternate).
 * ──────────────────────────────────────────────────────────────────────────── */

// 1 tap: PgUp, 2 taps: M-S-< (beginning of buffer)
ZMK_TAP_DANCE(td_pgup, bindings = <&kp PG_UP>, <&kp LA(LS(COMMA))>;)

// 1 tap: PgDn, 2 taps: M-S-> (end of buffer)
ZMK_TAP_DANCE(td_pgdn, bindings = <&kp PG_DN>, <&kp LA(LS(DOT))>;)

// 1 tap: C-s (isearch), 2 taps: M-C-S-% (query-replace-regexp)
ZMK_TAP_DANCE(td_csrc, bindings = <&kp LC(S)>, <&kp LA(LC(LS(PRCNT)))>;)

/* ── Combos ────────────────────────────────────────────────────────────────
 *
 * Ported from Moonlander combo definitions.
 * ──────────────────────────────────────────────────────────────────────────── */

#define COMBO_TERM_FAST 50
#define COMBO_IDLE_FAST 150

ZMK_COMBO(esc_combo,  &kp ESC,       LT3 LT4, DEF, COMBO_TERM_FAST, COMBO_IDLE_FAST)  // ',  → Esc
ZMK_COMBO(cw_combo,   &caps_word,    LT0 RT0, DEF, COMBO_TERM_FAST, COMBO_IDLE_FAST)  // Y+F → Caps Word

/* ── Conditional layer: FN + NUM → SYS ─────────────────────────────────────*/

ZMK_CONDITIONAL_LAYER(sys, FN NUM, SYS)

/* ── Layer macro fallback ──────────────────────────────────────────────────── */

#ifndef ZMK_BASE_LAYER
  #define ZMK_BASE_LAYER(name, LT, RT, LM, RM, LB, RB, LH, RH)               \
      ZMK_LAYER(name, LT RT LM RM LB RB LH RH)
#endif

/* ══════════════════════════════════════════════════════════════════════════
 *                              K E Y M A P
 * ══════════════════════════════════════════════════════════════════════════ */

/*  Layer 0 — Dvorak US
 *  ╭──────┬──────┬──────┬──────┬──────╮ ╭──────┬──────┬──────┬──────┬──────╮
 *  │  ' " │  , < │  . > │  P   │  Y   │ │  F   │  G   │  C   │  R   │  L   │
 *  ├──────┼──────┼──────┼──────┼──────┤ ├──────┼──────┼──────┼──────┼──────┤
 *  │  A   │  O   │  E   │  U   │  I   │ │  D   │  H   │  T   │  N   │  S   │
 *  │ SFT  │ ALT  │ GUI  │ CTRL │EmacsN│ │EmacsW│ CTRL │ GUI  │ ALT  │ SFT  │
 *  ├──────┼──────┼──────┼──────┼──────┤ ├──────┼──────┼──────┼──────┼──────┤
 *  │  ; : │  Q   │  J   │  K   │  X   │ │  B   │  M   │  W   │  V   │  Z   │
 *  ╰──────┴──────┴──────┼──────┼──────┼──────╮ ╭──────┼──────┼──────┴──────┴──────╯
 *                       │ DEL  │ SPC  │ ESC  │ │ TAB  │ BSPC │ ENT  │
 *                       │ SymR │ Num  │ Nav  │ │Mouse │  Fn  │ SymL │
 *                       ╰──────┴──────┴──────╯ ╰──────┴──────┴──────╯
 */
ZMK_BASE_LAYER(Base,
//╭─────────────┬─────────────┬─────────────┬─────────────┬─────────────╮ ╭─────────────┬─────────────┬─────────────┬─────────────┬─────────────╮
    &kp SQT       &kp COMMA     &kp DOT       &kp P         &kp Y       ,   &kp F         &kp G         &kp C         &kp R         &kp L       ,
//├─────────────┼─────────────┼─────────────┼─────────────┼─────────────┤ ├─────────────┼─────────────┼─────────────┼─────────────┼─────────────┤
    &hml_s LSHFT A &hml LALT O   &hml LGUI E   &hml LCTRL U  &hml_l EMACS_N I, &hmr_l EMACS_W D &hmr RCTRL H &hmr LGUI T  &hmr LALT N   &hmr_s RSHFT S,
//├─────────────┼─────────────┼─────────────┼─────────────┼─────────────┤ ├─────────────┼─────────────┼─────────────┼─────────────┼─────────────┤
    &kp SEMI      &kp Q         &kp J         &kp K         &kp X       ,   &kp B         &kp M         &kp W         &kp V         &kp Z       ,
//╰─────────────┼─────────────┴─────────────┼─────────────┼─────────────┤ ├─────────────┼─────────────┼─────────────┴───────────────────────────╯
                                &lt SYMR DEL  &lt NUM SPACE &lt NAV ESC  ,  &lt MOUSE TAB &lt FN BSPC   &lt SYML RET
//                            ╰─────────────┴─────────────┴─────────────╯ ╰─────────────┴─────────────┴─────────────╯
)

/*  Layer 1 — Symbols Left (hold ENT)
 *  Right side: symbols. Left side: transparent + sticky mods for chording.
 *  ╭──────┬──────┬──────┬──────┬──────╮ ╭──────┬──────┬──────┬──────┬──────╮
 *  │      │  @   │  #   │  $   │  %   │ │      │      │      │      │      │
 *  ├──────┼──────┼──────┼──────┼──────┤ ├──────┼──────┼──────┼──────┼──────┤
 *  │  +   │  =   │  (   │  )   │  "   │ │ LOCK │ CTRL │ GUI  │ ALT  │ SFT  │
 *  ├──────┼──────┼──────┼──────┼──────┤ ├──────┼──────┼──────┼──────┼──────┤
 *  │  <   │  |   │  -   │  >   │  \   │ │      │      │      │      │      │
 *  ╰──────┴──────┴──────┼──────┼──────┼──────╮ ╭──────┼──────┼──────┴──────┴──────╯
 *                       │      │      │      │ │      │      │ held │
 *                       ╰──────┴──────┴──────╯ ╰──────┴──────┴──────╯
 */
ZMK_BASE_LAYER(SymL,
//╭─────────────┬─────────────┬─────────────┬─────────────┬─────────────╮ ╭─────────────┬─────────────┬─────────────┬─────────────┬─────────────╮
    &kp EXCL      &kp AT        &kp HASH      &kp DLLR      &kp PRCNT   ,   ___           ___           ___           ___           ___         ,
//├─────────────┼─────────────┼─────────────┼─────────────┼─────────────┤ ├─────────────┼─────────────┼─────────────┼─────────────┼─────────────┤
    &kp PLUS      &kp EQUAL     &kp LPAR      &kp RPAR      &kp DQT     ,   &tog SYML     &kp RCTRL     &kp LGUI      &kp LALT      &kp RSHFT   ,
//├─────────────┼─────────────┼─────────────┼─────────────┼─────────────┤ ├─────────────┼─────────────┼─────────────┼─────────────┼─────────────┤
    &kp LT        &kp PIPE      &kp MINUS     &kp GT        &kp BSLH    ,   ___           ___           ___           ___           ___         ,
//╰─────────────┼─────────────┴─────────────┼─────────────┼─────────────┤ ├─────────────┼─────────────┼─────────────┴───────────────────────────╯
                                ___           ___           ___         ,   ___           ___           ___
//                            ╰─────────────┴─────────────┴─────────────╯ ╰─────────────┴─────────────┴─────────────╯
)

/*  Layer 2 — Symbols Right (hold DEL)
 *  Left side: sticky mods for chording. Right side: symbols.
 *  ╭──────┬──────┬──────┬──────┬──────╮ ╭──────┬──────┬──────┬──────┬──────╮
 *  │      │      │      │      │      │ │  ^   │  &   │  *   │  ?   │  '   │
 *  ├──────┼──────┼──────┼──────┼──────┤ ├──────┼──────┼──────┼──────┼──────┤
 *  │ SFT  │ ALT  │ GUI  │ CTRL │ LOCK │ │  :   │  ]   │  [   │  }   │  {   │
 *  ├──────┼──────┼──────┼──────┼──────┤ ├──────┼──────┼──────┼──────┼──────┤
 *  │      │      │      │      │      │ │  `   │  _   │  /   │  ~   │  ;   │
 *  ╰──────┴──────┴──────┼──────┼──────┼──────╮ ╭──────┼──────┼──────┴──────┴──────╯
 *                       │ held │      │      │ │      │      │      │
 *                       ╰──────┴──────┴──────╯ ╰──────┴──────┴──────╯
 */
ZMK_BASE_LAYER(SymR,
//╭─────────────┬─────────────┬─────────────┬─────────────┬─────────────╮ ╭─────────────┬─────────────┬─────────────┬─────────────┬─────────────╮
    ___           ___           ___           ___           ___         ,   &kp CARET     &kp AMPS      &kp ASTRK     &kp QMARK     &kp SQT     ,
//├─────────────┼─────────────┼─────────────┼─────────────┼─────────────┤ ├─────────────┼─────────────┼─────────────┼─────────────┼─────────────┤
    &kp LSHFT     &kp LALT      &kp LGUI      &kp LCTRL     &tog SYMR   ,   &kp COLON     &kp RBKT      &kp LBKT      &kp RBRC      &kp LBRC    ,
//├─────────────┼─────────────┼─────────────┼─────────────┼─────────────┤ ├─────────────┼─────────────┼─────────────┼─────────────┼─────────────┤
    ___           ___           ___           ___           ___         ,   &kp GRAVE     &kp UNDER     &kp FSLH      &kp TILDE     &kp SEMI    ,
//╰─────────────┼─────────────┴─────────────┼─────────────┼─────────────┤ ├─────────────┼─────────────┼─────────────┴───────────────────────────╯
                                ___           ___           ___         ,   ___           ___           ___
//                            ╰─────────────┴─────────────┴─────────────╯ ╰─────────────┴─────────────┴─────────────╯
)

/*  Layer 3 — Function keys (hold BSPC)
 *  ╭──────┬──────┬──────┬──────┬──────╮ ╭──────┬──────┬──────┬──────┬──────╮
 *  │ F12  │  F7  │  F8  │  F9  │      │ │      │      │      │      │      │
 *  ├──────┼──────┼──────┼──────┼──────┤ ├──────┼──────┼──────┼──────┼──────┤
 *  │ F11  │  F4  │  F5  │  F6  │PrtSc │ │ LOCK │ CTRL │ GUI  │ ALT  │ SFT  │
 *  ├──────┼──────┼──────┼──────┼──────┤ ├──────┼──────┼──────┼──────┼──────┤
 *  │ F10  │  F1  │  F2  │  F3  │      │ │      │      │      │      │      │
 *  ╰──────┴──────┴──────┼──────┼──────┼──────╮ ╭──────┼──────┼──────┴──────┴──────╯
 *                       │      │      │      │ │      │ held │      │
 *                       ╰──────┴──────┴──────╯ ╰──────┴──────┴──────╯
 */
ZMK_BASE_LAYER(Fn,
//╭─────────────┬─────────────┬─────────────┬─────────────┬─────────────╮ ╭─────────────┬─────────────┬─────────────┬─────────────┬─────────────╮
    &kp F12       &kp F7        &kp F8        &kp F9        ___         ,   ___           ___           ___           ___           ___         ,
//├─────────────┼─────────────┼─────────────┼─────────────┼─────────────┤ ├─────────────┼─────────────┼─────────────┼─────────────┼─────────────┤
    &kp F11       &kp F4        &kp F5        &kp F6        &kp PSCRN   ,   &tog FN       &kp RCTRL     &kp LGUI      &kp LALT      &kp RSHFT   ,
//├─────────────┼─────────────┼─────────────┼─────────────┼─────────────┤ ├─────────────┼─────────────┼─────────────┼─────────────┼─────────────┤
    &kp F10       &kp F1        &kp F2        &kp F3        ___         ,   ___           ___           ___           ___           ___         ,
//╰─────────────┼─────────────┴─────────────┼─────────────┼─────────────┤ ├─────────────┼─────────────┼─────────────┴───────────────────────────╯
                                ___           ___           ___         ,   ___           ___           ___
//                            ╰─────────────┴─────────────┴─────────────╯ ╰─────────────┴─────────────┴─────────────╯
)

/*  Layer 4 — Numbers (hold SPC)
 *  ╭──────┬──────┬──────┬──────┬──────╮ ╭──────┬──────┬──────┬──────┬──────╮
 *  │      │BRI Up│      │VolUp │      │ │  +   │  7   │  8   │  9   │  *   │
 *  ├──────┼──────┼──────┼──────┼──────┤ ├──────┼──────┼──────┼──────┼──────┤
 *  │ SFT  │ ALT  │ GUI  │ CTRL │ LOCK │ │  0   │  4   │  5   │  6   │  :   │
 *  ├──────┼──────┼──────┼──────┼──────┤ ├──────┼──────┼──────┼──────┼──────┤
 *  │      │BRI Dn│      │VolDn │      │ │  -   │  1   │  2   │  3   │  /   │
 *  ╰──────┴──────┴──────┼──────┼──────┼──────╮ ╭──────┼──────┼──────┴──────┴──────╯
 *                       │      │ held │      │ │      │      │      │
 *                       ╰──────┴──────┴──────╯ ╰──────┴──────┴──────╯
 */
ZMK_BASE_LAYER(Num,
//╭─────────────┬─────────────┬─────────────┬─────────────┬─────────────╮ ╭─────────────┬─────────────┬─────────────┬─────────────┬─────────────╮
    ___           &kp C_BRI_UP  ___           &kp C_VOL_UP  ___         ,   &kp PLUS      &kp N7        &kp N8        &kp N9        &kp ASTRK   ,
//├─────────────┼─────────────┼─────────────┼─────────────┼─────────────┤ ├─────────────┼─────────────┼─────────────┼─────────────┼─────────────┤
    &kp LSHFT     &kp LALT      &kp LGUI      &kp LCTRL     &tog NUM    ,   &kp N0        &kp N4        &kp N5        &kp N6        &kp COLON   ,
//├─────────────┼─────────────┼─────────────┼─────────────┼─────────────┤ ├─────────────┼─────────────┼─────────────┼─────────────┼─────────────┤
    ___           &kp C_BRI_DN  ___           &kp C_VOL_DN  ___         ,   &kp MINUS     &kp N1        &kp N2        &kp N3        &kp FSLH    ,
//╰─────────────┼─────────────┴─────────────┼─────────────┼─────────────┤ ├─────────────┼─────────────┼─────────────┴───────────────────────────╯
                                ___           ___           ___         ,   ___           ___           ___
//                            ╰─────────────┴─────────────┴─────────────╯ ╰─────────────┴─────────────┴─────────────╯
)

/*  Layer 5 — Navigation (hold ESC)
 *  ╭──────┬──────┬──────┬──────┬──────╮ ╭──────┬──────┬──────┬──────┬──────╮
 *  │      │      │      │      │      │ │      │ PgUp │  ↑   │ Home │      │
 *  ├──────┼──────┼──────┼──────┼──────┤ ├──────┼──────┼──────┼──────┼──────┤
 *  │ SFT  │ ALT  │ GUI  │ CTRL │ LOCK │ │      │  ←   │  ↓   │  →   │      │
 *  ├──────┼──────┼──────┼──────┼──────┤ ├──────┼──────┼──────┼──────┼──────┤
 *  │      │      │      │      │      │ │      │ PgDn │      │ End  │      │
 *  ╰──────┴──────┴──────┼──────┼──────┼──────╮ ╭──────┼──────┼──────┴──────┴──────╯
 *                       │      │      │ held │ │      │      │      │
 *                       ╰──────┴──────┴──────╯ ╰──────┴──────┴──────╯
 */
ZMK_BASE_LAYER(Nav,
//╭─────────────┬─────────────┬─────────────┬─────────────┬─────────────╮ ╭─────────────┬─────────────┬─────────────┬─────────────┬─────────────╮
    ___           ___           ___           ___           ___         ,   ___           &kp PG_UP     &kp UP        &kp HOME      ___         ,
//├─────────────┼─────────────┼─────────────┼─────────────┼─────────────┤ ├─────────────┼─────────────┼─────────────┼─────────────┼─────────────┤
    &kp LSHFT     &kp LALT      &kp LGUI      &kp LCTRL     &tog NAV    ,   ___           &kp LEFT      &kp DOWN      &kp RIGHT     ___         ,
//├─────────────┼─────────────┼─────────────┼─────────────┼─────────────┤ ├─────────────┼─────────────┼─────────────┼─────────────┼─────────────┤
    ___           ___           ___           ___           ___         ,   ___           &kp PG_DN     ___           &kp END       ___         ,
//╰─────────────┼─────────────┴─────────────┼─────────────┼─────────────┤ ├─────────────┼─────────────┼─────────────┴───────────────────────────╯
                                ___           ___           ___         ,   ___           ___           ___
//                            ╰─────────────┴─────────────┴─────────────╯ ╰─────────────┴─────────────┴─────────────╯
)

/*  Layer 6 — Mouse (hold TAB)
 *  ╭──────┬──────┬──────┬──────┬──────╮ ╭──────┬──────┬──────┬──────┬──────╮
 *  │ Btn3 │ Btn2 │ Ms↑  │ Btn1 │ Wh↑  │ │      │ Btn1 │      │ Btn2 │ Btn3 │
 *  ├──────┼──────┼──────┼──────┼──────┤ ├──────┼──────┼──────┼──────┼──────┤
 *  │      │ Ms←  │ Ms↓  │ Ms→  │ Wh↓  │ │ LOCK │ CTRL │ GUI  │ ALT  │ SFT  │
 *  ├──────┼──────┼──────┼──────┼──────┤ ├──────┼──────┼──────┼──────┼──────┤
 *  │      │ Wh←  │      │ Wh→  │      │ │      │      │      │      │      │
 *  ╰──────┴──────┴──────┼──────┼──────┼──────╮ ╭──────┼──────┼──────┴──────┴──────╯
 *                       │      │      │      │ │ held │      │      │
 *                       ╰──────┴──────┴──────╯ ╰──────┴──────┴──────╯
 */
ZMK_BASE_LAYER(Mouse,
//╭─────────────┬─────────────┬─────────────┬─────────────┬─────────────╮ ╭─────────────┬─────────────┬─────────────┬─────────────┬─────────────╮
    &mkp MCLK     &mkp RCLK     U_MS_U        &mkp LCLK     U_WH_U      ,   ___           &mkp LCLK     ___           &mkp RCLK     &mkp MCLK   ,
//├─────────────┼─────────────┼─────────────┼─────────────┼─────────────┤ ├─────────────┼─────────────┼─────────────┼─────────────┼─────────────┤
    ___           U_MS_L        U_MS_D        U_MS_R        U_WH_D      ,   &tog MOUSE    &kp RCTRL     &kp LGUI      &kp LALT      &kp RSHFT   ,
//├─────────────┼─────────────┼─────────────┼─────────────┼─────────────┤ ├─────────────┼─────────────┼─────────────┼─────────────┼─────────────┤
    ___           U_WH_L        ___           U_WH_R        ___         ,   ___           ___           ___           ___           ___         ,
//╰─────────────┼─────────────┴─────────────┼─────────────┼─────────────┤ ├─────────────┼─────────────┼─────────────┴───────────────────────────╯
                                ___           ___           ___         ,   ___           ___           ___
//                            ╰─────────────┴─────────────┴─────────────╯ ╰─────────────┴─────────────┴─────────────╯
)

/*  Layer 7 — Emacs Navigation (hold I)
 *  ╭──────┬──────┬──────┬──────┬──────╮ ╭──────┬──────┬──────┬──────┬──────╮
 *  │      │      │      │      │      │ │ M-b  │PgUp/│  ↑   │ C-a  │M-S-% │
 *  │      │      │      │      │      │ │      │ M<   │      │      │      │
 *  ├──────┼──────┼──────┼──────┼──────┤ ├──────┼──────┼──────┼──────┼──────┤
 *  │ SFT  │ ALT  │ GUI  │ CTRL │ held │ │ C-r  │  ←   │  ↓   │  →   │ C-s  │
 *  ├──────┼──────┼──────┼──────┼──────┤ ├──────┼──────┼──────┼──────┼──────┤
 *  │      │      │      │      │      │ │ M-f  │PgDn/│ C-s/ │ C-e  │C-S-- │
 *  │      │      │      │      │      │ │      │ M>   │ QRR  │      │      │
 *  ╰──────┴──────┴──────┼──────┼──────┼──────╮ ╭──────┼──────┼──────┴──────┴──────╯
 *                       │      │      │      │ │      │      │      │
 *                       ╰──────┴──────┴──────╯ ╰──────┴──────┴──────╯
 *
 *  Tap-dances (double-tap for alternate):
 *    PgUp/M< : 1 tap = PgUp,  2 taps = M-S-< (beginning of buffer)
 *    PgDn/M> : 1 tap = PgDn,  2 taps = M-S-> (end of buffer)
 *    C-s/QRR : 1 tap = C-s,   2 taps = M-C-S-% (query-replace-regexp)
 */
ZMK_BASE_LAYER(EmacsN,
//╭─────────────┬─────────────┬─────────────┬─────────────┬─────────────╮ ╭─────────────┬─────────────┬─────────────┬─────────────┬─────────────╮
    ___           ___           ___           ___           ___         ,   &kp LA(B)     &td_pgup      &kp UP        &kp LC(A)     &kp LA(LS(PRCNT)),
//├─────────────┼─────────────┼─────────────┼─────────────┼─────────────┤ ├─────────────┼─────────────┼─────────────┼─────────────┼─────────────┤
    &kp LSHFT     &kp LALT      &kp LGUI      &kp LCTRL     ___         ,   &kp LC(R)     &kp LEFT      &kp DOWN      &kp RIGHT     &kp LC(S)   ,
//├─────────────┼─────────────┼─────────────┼─────────────┼─────────────┤ ├─────────────┼─────────────┼─────────────┼─────────────┼─────────────┤
    ___           ___           ___           ___           ___         ,   &kp LA(F)     &td_pgdn      &td_csrc      &kp LC(E)     &kp LC(LS(MINUS)),
//╰─────────────┼─────────────┴─────────────┼─────────────┼─────────────┤ ├─────────────┼─────────────┼─────────────┴───────────────────────────╯
                                ___           ___           ___         ,   ___           ___           ___
//                            ╰─────────────┴─────────────┴─────────────╯ ╰─────────────┴─────────────┴─────────────╯
)

/*  Layer 8 — Emacs Window/Buffer (hold D)
 *  ╭──────┬──────┬──────┬──────┬──────╮ ╭──────┬──────┬──────┬──────┬──────╮
 *  │C-x 0 │C-x 3 │C-x 2 │C-x 1 │C-Bspc│ │      │      │      │      │      │
 *  ├──────┼──────┼──────┼──────┼──────┤ ├──────┼──────┼──────┼──────┼──────┤
 *  │      │C-x o │C-x b │C-xC-s│ C-k  │ │ held │ CTRL │ GUI  │ ALT  │ SFT  │
 *  ├──────┼──────┼──────┼──────┼──────┤ ├──────┼──────┼──────┼──────┼──────┤
 *  │C-xC-w│C-x k │      │C-xC-f│C-Del │ │      │      │      │      │      │
 *  ╰──────┴──────┴──────┼──────┼──────┼──────╮ ╭──────┼──────┼──────┴──────┴──────╯
 *                       │      │      │      │ │      │      │      │
 *                       ╰──────┴──────┴──────╯ ╰──────┴──────┴──────╯
 */
ZMK_BASE_LAYER(EmacsW,
//╭─────────────┬─────────────┬─────────────┬─────────────┬─────────────╮ ╭─────────────┬─────────────┬─────────────┬─────────────┬─────────────╮
    &cx_0         &cx_3         &cx_2         &cx_1         &kp LC(BSPC),   ___           ___           ___           ___           ___         ,
//├─────────────┼─────────────┼─────────────┼─────────────┼─────────────┤ ├─────────────┼─────────────┼─────────────┼─────────────┼─────────────┤
    ___           &cx_o         &cx_b         &cx_cs        &kp LC(K)   ,   ___           &kp RCTRL     &kp LGUI      &kp LALT      &kp RSHFT   ,
//├─────────────┼─────────────┼─────────────┼─────────────┼─────────────┤ ├─────────────┼─────────────┼─────────────┼─────────────┼─────────────┤
    &cx_cw        &cx_k         ___           &cx_cf        &kp LC(DEL) ,   ___           ___           ___           ___           ___         ,
//╰─────────────┼─────────────┴─────────────┼─────────────┼─────────────┤ ├─────────────┼─────────────┼─────────────┴───────────────────────────╯
                                ___           ___           ___         ,   ___           ___           ___
//                            ╰─────────────┴─────────────┴─────────────╯ ╰─────────────┴─────────────┴─────────────╯
)

/*  Layer 9 — System (activated by FN + NUM simultaneously)
 *  ╭──────┬──────┬──────┬──────┬──────╮ ╭──────┬──────┬──────┬──────┬──────╮
 *  │ BT 0 │ BT 1 │ BT 2 │ BT 3 │BT CLR│ │RGB Tg│Unlock│      │      │      │
 *  ├──────┼──────┼──────┼──────┼──────┤ ├──────┼──────┼──────┼──────┼──────┤
 *  │O: USB│O: BLE│O: Tog│      │ Boot │ │ Boot │      │      │      │      │
 *  ├──────┼──────┼──────┼──────┼──────┤ ├──────┼──────┼──────┼──────┼──────┤
 *  │      │      │      │      │ Reset│ │ Reset│      │      │      │      │
 *  ╰──────┴──────┴──────┼──────┼──────┼──────╮ ╭──────┼──────┼──────┴──────┴──────╯
 *                       │      │      │      │ │      │      │      │
 *                       ╰──────┴──────┴──────╯ ╰──────┴──────┴──────╯
 */
#ifdef CONFIG_WIRELESS
  #define _OUT_KEYS_ &out OUT_USB &out OUT_BLE &out OUT_TOG
#else
  #define _OUT_KEYS_ &trans &trans &trans
#endif

ZMK_BASE_LAYER(Sys,
//╭─────────────┬─────────────┬─────────────┬─────────────┬─────────────╮ ╭─────────────┬─────────────┬─────────────┬─────────────┬─────────────╮
                               _BT_SEL_KEYS_                            ,   _RGB_TOG_     &studio_unlock ___          ___           ___         ,
//├─────────────┼─────────────┼─────────────┼─────────────┼─────────────┤ ├─────────────┼─────────────┼─────────────┼─────────────┼─────────────┤
    _OUT_KEYS_                                ___           &bootloader ,   &bootloader   ___           ___           ___           ___         ,
//├─────────────┼─────────────┼─────────────┼─────────────┼─────────────┤ ├─────────────┼─────────────┼─────────────┼─────────────┼─────────────┤
    ___           ___           ___           ___           &sys_reset  ,   &sys_reset    ___           ___           ___           ___         ,
//╰─────────────┼─────────────┴─────────────┼─────────────┼─────────────┤ ├─────────────┼─────────────┼─────────────┴───────────────────────────╯
                                ___           ___           ___         ,   ___           ___           ___
//                            ╰─────────────┴─────────────┴─────────────╯ ╰─────────────┴─────────────┴─────────────╯
)

/* vim: set ft=c tw=146: */
