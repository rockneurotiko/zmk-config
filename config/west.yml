## config/west.yml
```yaml
manifest:
  remotes:
    - name: zmkfirmware
      url-base: https://github.com/zmkfirmware
    - name: urob
      url-base: https://github.com/urob
    # - name: mctechnology17
    #   url-base: https://github.com/mctechnology17
    - name: zzeneg
      url-base: https://github.com/zzeneg
    - name: srwi
      url-base: https://github.com/srwi
  projects:
    - name: zmk
      remote: zmkfirmware
      revision: v0.3
      import: app/west.yml

    # Urob's helper macros: ZMK_HOLD_TAP, ZMK_LAYER, ZMK_COMBO, etc.
    - name: zmk-helpers
      remote: urob
      revision: v0.3 # Should match ZMK release.

    # nice!view custom display — replaced by local nice_view_battery shield.
    # - name: zmk-nice-oled
    #   remote: mctechnology17
    #   revision: 46f824abb2bd41f1287c5c68abd14122af6042a3

    # Raw HID transport (required for KeyPeek layer sync).
    - name: zmk-raw-hid
      remote: zzeneg
      revision: main

    # KeyPeek layer notifier (sends layer state to KeyPeek overlay app).
    - name: zmk-keypeek-layer-notifier
      remote: srwi
      revision: master

    # ── Optional modules (uncomment to enable) ──────────────────────────
    # Adaptive key (for magic-shift / repeat key):
    # - name: zmk-adaptive-key
    #   remote: urob
    #   revision: main
    #   path: modules/zmk/adaptive-key
    #
    # Auto-layer (for numword — auto-deactivating number layer):
    # - name: zmk-auto-layer
    #   remote: urob
    #   revision: main
    #   path: modules/zmk/auto-layer
    #
    # Tri-state (for smart-mouse and alt-tab swapper):
    # - name: zmk-tri-state
    #   remote: urob
    #   revision: main
    #   path: modules/zmk/tri-state
    #
    # Leader key (for Unicode input and system commands):
    # - name: zmk-leader-key
    #   remote: urob
    #   revision: main
    #   path: modules/zmk/leader-key
    #
    # Unicode (for Umlauts, Greek letters, etc.):
    # - name: zmk-unicode
    #   remote: urob
    #   revision: main
    #   path: modules/zmk/unicode

  self:
    path: config
```
